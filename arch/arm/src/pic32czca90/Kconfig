## arch/arm/src/pic32czca90/Kconfig
```kconfig
#
# For a description of the syntax of this configuration file,
# see the file kconfig-language.txt in the NuttX tools repository.
#

comment "Microchip PIC32CZ CA90 Configuration Options"

menu "PIC32CZ CA90 Peripheral Support"

config PIC32CZCA90_SERCOM
	bool
	default n

config PIC32CZCA90_TCC
	bool
	default n

config PIC32CZCA90_DMAC
	bool "DMA Controller"
	default n
	select ARCH_DMA

# SERCOM0-9 (CA90 has 10 SERCOMs)

config PIC32CZCA90_SERCOM0
	bool "Serial Communication Interface 0"
	default n
	select PIC32CZCA90_SERCOM

config PIC32CZCA90_SERCOM1
	bool "Serial Communication Interface 1"
	default n
	select PIC32CZCA90_SERCOM

config PIC32CZCA90_SERCOM2
	bool "Serial Communication Interface 2"
	default n
	select PIC32CZCA90_SERCOM

config PIC32CZCA90_SERCOM3
	bool "Serial Communication Interface 3"
	default n
	select PIC32CZCA90_SERCOM

config PIC32CZCA90_SERCOM4
	bool "Serial Communication Interface 4"
	default n
	select PIC32CZCA90_SERCOM

config PIC32CZCA90_SERCOM5
	bool "Serial Communication Interface 5"
	default n
	select PIC32CZCA90_SERCOM

config PIC32CZCA90_SERCOM6
	bool "Serial Communication Interface 6"
	default n
	select PIC32CZCA90_SERCOM

config PIC32CZCA90_SERCOM7
	bool "Serial Communication Interface 7"
	default n
	select PIC32CZCA90_SERCOM

config PIC32CZCA90_SERCOM8
	bool "Serial Communication Interface 8"
	default n
	select PIC32CZCA90_SERCOM

config PIC32CZCA90_SERCOM9
	bool "Serial Communication Interface 9"
	default n
	select PIC32CZCA90_SERCOM

# CAN-FD — CA90 has 6 MCAN instances (CAN0-5)

config PIC32CZCA90_CAN0
	bool "CAN-FD 0"
	default n

config PIC32CZCA90_CAN1
	bool "CAN-FD 1"
	default n

config PIC32CZCA90_CAN2
	bool "CAN-FD 2"
	default n

config PIC32CZCA90_CAN3
	bool "CAN-FD 3"
	default n

config PIC32CZCA90_CAN4
	bool "CAN-FD 4"
	default n

config PIC32CZCA90_CAN5
	bool "CAN-FD 5"
	default n

config PIC32CZCA90_GMAC
	bool "Ethernet MAC"
	default n
	select NETDEVICES
	select ARCH_HAVE_PHY

config PIC32CZCA90_USB
	bool "USB"
	default n

config PIC32CZCA90_ADC0
	bool "Analog-to-Digital Converter 0"
	default n

config PIC32CZCA90_ADC1
	bool "Analog-to-Digital Converter 1"
	default n

config PIC32CZCA90_DAC
	bool "Digital-to-Analog Converter"
	default n

# TCC0-9 — CA90 has 10 TCC instances; no plain TC (NTC=0)

config PIC32CZCA90_TCC0
	bool "Timer/Counter for Control 0"
	default n
	select PIC32CZCA90_TCC

config PIC32CZCA90_TCC1
	bool "Timer/Counter for Control 1"
	default n
	select PIC32CZCA90_TCC

config PIC32CZCA90_TCC2
	bool "Timer/Counter for Control 2"
	default n
	select PIC32CZCA90_TCC

config PIC32CZCA90_TCC3
	bool "Timer/Counter for Control 3"
	default n
	select PIC32CZCA90_TCC

config PIC32CZCA90_TCC4
	bool "Timer/Counter for Control 4"
	default n
	select PIC32CZCA90_TCC

config PIC32CZCA90_TCC5
	bool "Timer/Counter for Control 5"
	default n
	select PIC32CZCA90_TCC

config PIC32CZCA90_TCC6
	bool "Timer/Counter for Control 6"
	default n
	select PIC32CZCA90_TCC

config PIC32CZCA90_TCC7
	bool "Timer/Counter for Control 7"
	default n
	select PIC32CZCA90_TCC

config PIC32CZCA90_TCC8
	bool "Timer/Counter for Control 8"
	default n
	select PIC32CZCA90_TCC

config PIC32CZCA90_TCC9
	bool "Timer/Counter for Control 9"
	default n
	select PIC32CZCA90_TCC

# CA90 has SQI (Serial Quad Interface), not QSPI

config PIC32CZCA90_SQI
	bool "SQI (Serial Quad Interface)"
	default n

config PIC32CZCA90_RTC
	bool "Real Time Counter"
	default n

config PIC32CZCA90_WDT
	bool "Watchdog Timer"
	default n

config PIC32CZCA90_EIC
	bool "External Interrupt Controller"
	default n

config PIC32CZCA90_NVMCTRL
	bool "Non-Volatile Memory Controller"
	default n

config PIC32CZCA90_TRNG
	bool "True Random Number Generator"
	default n

config PIC32CZCA90_AES
	bool "AES Encryption Engine"
	default n

config PIC32CZCA90_ICM
	bool "Integrity Check Monitor"
	default n

config PIC32CZCA90_I2S
	bool "I2S"
	default n

config PIC32CZCA90_AC
	bool "Analog Comparator"
	default n

endmenu # PIC32CZ CA90 Peripheral Support

menu "SERCOM Configuration"
	depends on PIC32CZCA90_SERCOM

choice
	prompt "SERCOM0 mode"
	default PIC32CZCA90_SERCOM0_ISUSART
	depends on PIC32CZCA90_SERCOM0

config PIC32CZCA90_SERCOM0_ISI2C
	bool "I2C Master"
	select I2C

config PIC32CZCA90_SERCOM0_ISSPI
	bool "SPI"
	select SPI

config PIC32CZCA90_SERCOM0_ISUSART
	bool "USART"
	select USART0_SERIALDRIVER

endchoice

choice
	prompt "SERCOM1 mode"
	default PIC32CZCA90_SERCOM1_ISUSART
	depends on PIC32CZCA90_SERCOM1

config PIC32CZCA90_SERCOM1_ISI2C
	bool "I2C Master"
	select I2C

config PIC32CZCA90_SERCOM1_ISSPI
	bool "SPI"
	select SPI

config PIC32CZCA90_SERCOM1_ISUSART
	bool "USART"
	select USART1_SERIALDRIVER

endchoice

choice
	prompt "SERCOM2 mode"
	default PIC32CZCA90_SERCOM2_ISUSART
	depends on PIC32CZCA90_SERCOM2

config PIC32CZCA90_SERCOM2_ISI2C
	bool "I2C Master"
	select I2C

config PIC32CZCA90_SERCOM2_ISSPI
	bool "SPI"
	select SPI

config PIC32CZCA90_SERCOM2_ISUSART
	bool "USART"
	select USART2_SERIALDRIVER

endchoice

choice
	prompt "SERCOM3 mode"
	default PIC32CZCA90_SERCOM3_ISUSART
	depends on PIC32CZCA90_SERCOM3

config PIC32CZCA90_SERCOM3_ISI2C
	bool "I2C Master"
	select I2C

config PIC32CZCA90_SERCOM3_ISSPI
	bool "SPI"
	select SPI

config PIC32CZCA90_SERCOM3_ISUSART
	bool "USART"
	select USART3_SERIALDRIVER

endchoice

choice
	prompt "SERCOM4 mode"
	default PIC32CZCA90_SERCOM4_ISUSART
	depends on PIC32CZCA90_SERCOM4

config PIC32CZCA90_SERCOM4_ISI2C
	bool "I2C Master"
	select I2C

config PIC32CZCA90_SERCOM4_ISSPI
	bool "SPI"
	select SPI

config PIC32CZCA90_SERCOM4_ISUSART
	bool "USART"
	select USART4_SERIALDRIVER

endchoice

choice
	prompt "SERCOM5 mode"
	default PIC32CZCA90_SERCOM5_ISUSART
	depends on PIC32CZCA90_SERCOM5

config PIC32CZCA90_SERCOM5_ISI2C
	bool "I2C Master"
	select I2C

config PIC32CZCA90_SERCOM5_ISSPI
	bool "SPI"
	select SPI

config PIC32CZCA90_SERCOM5_ISUSART
	bool "USART"
	select USART5_SERIALDRIVER

endchoice

choice
	prompt "SERCOM6 mode"
	default PIC32CZCA90_SERCOM6_ISUSART
	depends on PIC32CZCA90_SERCOM6

config PIC32CZCA90_SERCOM6_ISI2C
	bool "I2C Master"
	select I2C

config PIC32CZCA90_SERCOM6_ISSPI
	bool "SPI"
	select SPI

config PIC32CZCA90_SERCOM6_ISUSART
	bool "USART"
	select USART6_SERIALDRIVER

endchoice

choice
	prompt "SERCOM7 mode"
	default PIC32CZCA90_SERCOM7_ISUSART
	depends on PIC32CZCA90_SERCOM7

config PIC32CZCA90_SERCOM7_ISI2C
	bool "I2C Master"
	select I2C

config PIC32CZCA90_SERCOM7_ISSPI
	bool "SPI"
	select SPI

config PIC32CZCA90_SERCOM7_ISUSART
	bool "USART"
	select USART7_SERIALDRIVER

endchoice

choice
	prompt "SERCOM8 mode"
	default PIC32CZCA90_SERCOM8_ISUSART
	depends on PIC32CZCA90_SERCOM8

config PIC32CZCA90_SERCOM8_ISI2C
	bool "I2C Master"
	select I2C

config PIC32CZCA90_SERCOM8_ISSPI
	bool "SPI"
	select SPI

config PIC32CZCA90_SERCOM8_ISUSART
	bool "USART"
	select USART8_SERIALDRIVER

endchoice

choice
	prompt "SERCOM9 mode"
	default PIC32CZCA90_SERCOM9_ISUSART
	depends on PIC32CZCA90_SERCOM9

config PIC32CZCA90_SERCOM9_ISI2C
	bool "I2C Master"
	select I2C

config PIC32CZCA90_SERCOM9_ISSPI
	bool "SPI"
	select SPI

config PIC32CZCA90_SERCOM9_ISUSART
	bool "USART"
	select USART9_SERIALDRIVER

endchoice
endmenu # SERCOM Configuration
```
